## config/boards/arm/ckp/Kconfig.board
```kconfig
# CKP boards configuration

# Copyright (c) 2022 The ZMK Contributors
# SPDX-License-Identifier: MIT

config BOARD_BT60_V2
    bool "bt60_v2"
    depends on SOC_NRF52840_QIAA
```
